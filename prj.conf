## CMakeLists.txt
```
# SPDX-License-Identifier: Apache-2.0

cmake_minimum_required(VERSION 3.13.1)

include($ENV{ZEPHYR_BASE}/cmake/app/boilerplate.cmake NO_POLICY_SCOPE)
project(coap_client)

if(CONFIG_MBEDTLS_KEY_EXCHANGE_PSK_ENABLED AND
    (CONFIG_NET_SAMPLE_PSK_HEADER_FILE STREQUAL "dummy_psk.h"))
  add_custom_target(development_psk
    COMMAND ${CMAKE_COMMAND} -E echo "----------------------------------------------------------"
    COMMAND ${CMAKE_COMMAND} -E echo "--- WARNING: Using dummy PSK! Only suitable for        ---"
    COMMAND ${CMAKE_COMMAND} -E echo "--- development. Set NET_SAMPLE_PSK_HEADER_FILE to use ---"
    COMMAND ${CMAKE_COMMAND} -E echo "--- own pre-shared key.                                ---"
    COMMAND ${CMAKE_COMMAND} -E echo "----------------------------------------------------------"
  )
  add_dependencies(app development_psk)
endif()

FILE(GLOB utils_sources src/utils/*.c)
FILE(GLOB hal_sources src/hal/*.c)
FILE(GLOB drivers_sources src/drivers/*.c)
FILE(GLOB app_sources src/app/*.c)

target_sources(app PRIVATE src/main.c)
target_sources(app PRIVATE ${hal_sources})
target_sources(app PRIVATE ${drivers_sources})
target_sources(app PRIVATE ${app_sources})
target_sources(app PRIVATE ${utils_sources})

target_include_directories(app PRIVATE $ENV{ZEPHYR_BASE}/subsys/net/ip)
target_include_directories(app PRIVATE include)


include($ENV{ZEPHYR_BASE}/samples/net/common/common.cmake)

set(gen_dir ${ZEPHYR_BINARY_DIR}/include/generated/)

generate_inc_file_for_target(
    app
    src/echo-apps-cert.der
    ${gen_dir}/echo-apps-cert.der.inc
    )
```

## prj.conf
```kconfig
# Generic networking options
CONFIG_NETWORKING=y
CONFIG_NET_UDP=y
CONFIG_NET_TCP=y
CONFIG_NET_IPV6=y
CONFIG_NET_IPV4=y
CONFIG_NET_SOCKETS=y
CONFIG_NET_SOCKETS_POSIX_NAMES=y
CONFIG_NET_SOCKETS_POLL_MAX=4
CONFIG_NET_CONNECTION_MANAGER=y

# Kernel options
CONFIG_MAIN_STACK_SIZE=2048
CONFIG_ENTROPY_GENERATOR=y
CONFIG_TEST_RANDOM_GENERATOR=y
CONFIG_INIT_STACKS=y

CONFIG_COAP=y

# Logging
CONFIG_NET_LOG=y
CONFIG_LOG=y
CONFIG_NET_STATISTICS=y
CONFIG_PRINTK=y

# Network buffers
CONFIG_NET_PKT_RX_COUNT=16
CONFIG_NET_PKT_TX_COUNT=16
CONFIG_NET_BUF_RX_COUNT=80
CONFIG_NET_BUF_TX_COUNT=80
CONFIG_NET_CONTEXT_NET_PKT_POOL=y

# IP address options
CONFIG_NET_IF_UNICAST_IPV6_ADDR_COUNT=3
CONFIG_NET_IF_MCAST_IPV6_ADDR_COUNT=4
CONFIG_NET_MAX_CONTEXTS=10

# Network shell
CONFIG_NET_SHELL=y

# The addresses are selected so that qemu<->qemu connectivity works ok.
# For linux<->qemu connectivity, create a new conf file and swap the
# addresses (so that peer address is ending to 2).
CONFIG_NET_CONFIG_SETTINGS=y
CONFIG_NET_CONFIG_NEED_IPV6=y
CONFIG_NET_CONFIG_MY_IPV6_ADDR="2001:db8::2"
CONFIG_NET_CONFIG_PEER_IPV6_ADDR="2001:db8::1"
CONFIG_NET_CONFIG_MY_IPV4_ADDR="192.0.2.2"
CONFIG_NET_CONFIG_PEER_IPV4_ADDR="192.0.2.1"

# CONFIG_LOG_DEFAULT_LEVEL=4
CONFIG_LOG_BUFFER_SIZE=10000
CONFIG_LOG_STRDUP_BUF_COUNT=20
CONFIG_HEAP_MEM_POOL_SIZE=2048
```

## overlay-ot.conf
```kconfig
CONFIG_CPLUSPLUS=y

CONFIG_BT=n

# Disable TCP and IPv4 (TCP disabled to avoid heavy traffic)
CONFIG_NET_TCP=n
CONFIG_NET_IPV4=n

CONFIG_NET_IPV6_NBR_CACHE=n
CONFIG_NET_IPV6_MLD=n
CONFIG_NET_CONFIG_NEED_IPV6=y
CONFIG_NET_CONFIG_NEED_IPV4=n
CONFIG_NET_CONFIG_MY_IPV4_ADDR=""
CONFIG_NET_CONFIG_PEER_IPV4_ADDR=""

CONFIG_SYSTEM_WORKQUEUE_STACK_SIZE=2048
CONFIG_NET_TX_STACK_SIZE=2048
CONFIG_NET_RX_STACK_SIZE=5120
CONFIG_SHELL_STACK_SIZE=3072

CONFIG_NET_L2_OPENTHREAD=y

CONFIG_OPENTHREAD_DEBUG=y
CONFIG_OPENTHREAD_L2_DEBUG=y
CONFIG_OPENTHREAD_L2_LOG_LEVEL_INF=y
CONFIG_OPENTHREAD_L2_LOG_LEVEL_DBG=y

CONFIG_OPENTHREAD_CHANNEL=26

CONFIG_NET_CONFIG_MY_IPV6_ADDR="fdde:ad00:beef::1"
CONFIG_NET_CONFIG_PEER_IPV6_ADDR="fdde:ad11:11de:0:ce30:a933:976a:af68"
# Thread by default registers quite a lot addresses.
CONFIG_NET_IF_UNICAST_IPV6_ADDR_COUNT=6
CONFIG_NET_IF_MCAST_IPV6_ADDR_COUNT=8

# Other OpenThread dependencies (flash for OT persistent storage)
CONFIG_FLASH=y
CONFIG_FLASH_PAGE_LAYOUT=y
CONFIG_MPU_ALLOW_FLASH_WRITE=y

CONFIG_REBOOT=y

# mbedTLS tweaks
CONFIG_MBEDTLS_SSL_MAX_CONTENT_LEN=768

# A sample configuration to enable Thread Joiner, uncomment if needed
CONFIG_OPENTHREAD_JOINER=y
CONFIG_OPENTHREAD_JOINER_AUTOSTART=y
CONFIG_MBEDTLS_HEAP_SIZE=8192
CONFIG_OPENTHREAD_L2_DEBUG_DUMP_IPV6=y
CONFIG_OPENTHREAD_L2_DEBUG=y
```

## src/main.c
```c
/* echo-client.c - Networking echo client */

/*
 * Copyright (c) 2017 Intel Corporation.
 * Copyright (c) 2018 Nordic Semiconductor ASA.
 *
 * SPDX-License-Identifier: Apache-2.0
 */

/*
 * The echo-client application is acting as a client that is run in Zephyr OS,
 * and echo-server is run in the host acting as a server. The client will send
 * either unicast or multicast packets to the server which will reply the packet
 * back to the originator.
 *
 * In this sample application we create four threads that start to send data.
 * This might not be what you want to do in your app so caveat emptor.
 */

#include "app/app.h"

void main(void)
{
    start_app();
}
```

## include/coap_client.h
```c
#ifndef __COAP_CLIENT_H__
#define __COAP_CLIENT_H__

int start_coap_client(void);
int send_simple_coap_msgs_and_wait_for_reply(void);

#endif /* __COAP_CLIENT_H__ */
```

## src/coap_client.c
```c
/*
 * Copyright (c) 2018 Intel Corporation
 *
 * SPDX-License-Identifier: Apache-2.0
 */

#include <logging/log.h>
LOG_MODULE_REGISTER(net_coap_client_sample, LOG_LEVEL_DBG);

#include <errno.h>
#include <sys/printk.h>
#include <sys/byteorder.h>
#include <zephyr.h>

#include <net/socket.h>
#include <net/net_mgmt.h>
#include <net/net_ip.h>
#include <net/udp.h>
#include <net/coap.h>

#include "net_private.h"
#include "coap_client.h"
#include "kernel.h"

#define PEER_PORT 5683
#define CONFIG_NET_CONFIG_PEER_IPV6_ADDR "fdde:ad11:11de:0:ce30:a933:976a:af68"
#define MAX_COAP_MSG_LEN 256

/* CoAP socket fd */
static int sock;

struct pollfd fds[1];
static int nfds;

/* CoAP Options */
static const char *const test_path[] = {"test", NULL};

static const char *const large_path[] = {"large", NULL};

static const char *const obs_path[] = {"obs", NULL};

#define BLOCK_WISE_TRANSFER_SIZE_GET 2048

static struct coap_block_context blk_ctx;

static void wait(void)
{
    if (poll(fds, nfds, K_FOREVER) < 0)
    {
        LOG_ERR("Error in poll:%d", errno);
    }
}

static void prepare_fds(void)
{
    fds[nfds].fd = sock;
    fds[nfds].events = POLLIN;
    nfds++;
}

int start_coap_client(void)
{
    int ret = 0;
    struct sockaddr_in6 addr6;

    addr6.sin6_family = AF_INET6;
    addr6.sin6_port = htons(PEER_PORT);
    addr6.sin6_scope_id = 0U;

    inet_pton(AF_INET6, CONFIG_NET_CONFIG_PEER_IPV6_ADDR,
              &addr6.sin6_addr);

    sock = socket(addr6.sin6_family, SOCK_DGRAM, IPPROTO_UDP);
    if (sock < 0)
    {
        LOG_ERR("Failed to create UDP socket %d", errno);
        return -errno;
    }

    ret = connect(sock, (struct sockaddr *)&addr6, sizeof(addr6));
    if (ret < 0)
    {
        LOG_ERR("Cannot connect to UDP remote : %d", errno);
        return -errno;
    }

    prepare_fds();

    return 0;
}

static int process_simple_coap_reply(void)
{
    struct coap_packet reply;
    u8_t *data;
    int rcvd;
    int ret;

    wait();

    data = (u8_t *)k_malloc(MAX_COAP_MSG_LEN);
    if (!data)
    {
        return -ENOMEM;
    }

    rcvd = recv(sock, data, MAX_COAP_MSG_LEN, MSG_DONTWAIT);
    if (rcvd == 0)
    {
        ret = -EIO;
        goto end;
    }

    if (rcvd < 0)
    {
        if (errno == EAGAIN || errno == EWOULDBLOCK)
        {
            ret = 0;
        }
        else
        {
            ret = -errno;
        }

        goto end;
    }

    net_hexdump("Response", data, rcvd);

    ret = coap_packet_parse(&reply, data, rcvd, NULL, 0);
    if (ret < 0)
    {
        LOG_ERR("Invalid data received");
    }

end:
    k_free(data);

    return ret;
}

static int send_simple_coap_request(u8_t method)
{
    u8_t payload[] = "payload";
    struct coap_packet request;
    const char *const *p;
    u8_t *data;
    int r;

    data = (u8_t *)k_malloc(MAX_COAP_MSG_LEN);
    if (!data)
    {
        return -ENOMEM;
    }

    r = coap_packet_init(&request, data, MAX_COAP_MSG_LEN,
                         1, COAP_TYPE_CON, 8, coap_next_token(),
                         method, coap_next_id());
    if (r < 0)
    {
        LOG_ERR("Failed to init CoAP message");
        goto end;
    }

    for (p = test_path; p && *p; p++)
    {
        r = coap_packet_append_option(&request, COAP_OPTION_URI_PATH,
                                      *p, strlen(*p));
        if (r < 0)
        {
            LOG_ERR("Unable add option to request");
            goto end;
        }
    }

    switch (method)
    {
    case COAP_METHOD_GET:
    case COAP_METHOD_DELETE:
        break;

    case COAP_METHOD_PUT:
    case COAP_METHOD_POST:
        r = coap_packet_append_payload_marker(&request);
        if (r < 0)
        {
            LOG_ERR("Unable to append payload marker");
            goto end;
        }

        r = coap_packet_append_payload(&request, (u8_t *)payload,
                                       sizeof(payload) - 1);
        if (r < 0)
        {
            LOG_ERR("Not able to append payload");
            goto end;
        }

        break;
    default:
        r = -EINVAL;
        goto end;
    }

    net_hexdump("Request", request.data, request.offset);

    r = send(sock, request.data, request.offset, 0);

end:
    k_free(data);

    return 0;
}

int send_simple_coap_msgs_and_wait_for_reply(void)
{
    u8_t test_type = 0U;
    int r;

    while (1)
    {
        switch (test_type)
        {
        case 0:
            /* Test CoAP GET method */
            printk("\nCoAP client GET\n");
            r = send_simple_coap_request(COAP_METHOD_GET);
            if (r < 0)
            {
                return r;
            }

            break;
        case 1:
            /* Test CoAP PUT method */
            printk("\nCoAP client PUT\n");
            r = send_simple_coap_request(COAP_METHOD_PUT);
            if (r < 0)
            {
                return r;
            }

            break;
        case 2:
            /* Test CoAP POST method*/
            printk("\nCoAP client POST\n");
            r = send_simple_coap_request(COAP_METHOD_POST);
            if (r < 0)
            {
                return r;
            }

            break;
        case 3:
            /* Test CoAP DELETE method*/
            printk("\nCoAP client DELETE\n");
            r = send_simple_coap_request(COAP_METHOD_DELETE);
            if (r < 0)
            {
                return r;
            }

            break;
        default:
            return 0;
        }

        // r = process_simple_coap_reply();
        // if (r < 0)
        // {
        //     return r;
        // }

        test_type++;
    }

    return 0;
}

static int process_large_coap_reply(void)
{
    struct coap_packet reply;
    u8_t *data;
    bool last_block;
    int rcvd;
    int ret;

    wait();

    data = (u8_t *)k_malloc(MAX_COAP_MSG_LEN);
    if (!data)
    {
        return -ENOMEM;
    }

    rcvd = recv(sock, data, MAX_COAP_MSG_LEN, MSG_DONTWAIT);
    if (rcvd == 0)
    {
        ret = -EIO;
        goto end;
    }

    if (rcvd < 0)
    {
        if (errno == EAGAIN || errno == EWOULDBLOCK)
        {
            ret = 0;
        }
        else
        {
            ret = -errno;
        }

        goto end;
    }

    net_hexdump("Response", data, rcvd);

    ret = coap_packet_parse(&reply, data, rcvd, NULL, 0);
    if (ret < 0)
    {
        LOG_ERR("Invalid data received");
        goto end;
    }

    ret = coap_update_from_block(&reply, &blk_ctx);
    if (ret < 0)
    {
        goto end;
    }

    last_block = coap_next_block(&reply, &blk_ctx);
    if (!last_block)
    {
        ret = 1;
        goto end;
    }

    ret = 0;

end:
    k_free(data);

    return ret;
}

static int send_large_coap_request(void)
{
    struct coap_packet request;
    const char *const *p;
    u8_t *data;
    int r;

    if (blk_ctx.total_size == 0)
    {
        coap_block_transfer_init(&blk_ctx, COAP_BLOCK_64,
                                 BLOCK_WISE_TRANSFER_SIZE_GET);
    }

    data = (u8_t *)k_malloc(MAX_COAP_MSG_LEN);
    if (!data)
    {
        return -ENOMEM;
    }

    r = coap_packet_init(&request, data, MAX_COAP_MSG_LEN,
                         1, COAP_TYPE_CON, 8, coap_next_token(),
                         COAP_METHOD_GET, coap_next_id());
    if (r < 0)
    {
        LOG_ERR("Failed to init CoAP message");
        goto end;
    }

    for (p = large_path; p && *p; p++)
    {
        r = coap_packet_append_option(&request, COAP_OPTION_URI_PATH,
                                      *p, strlen(*p));
        if (r < 0)
        {
            LOG_ERR("Unable add option to request");
            goto end;
        }
    }

    r = coap_append_block2_option(&request, &blk_ctx);
    if (r < 0)
    {
        LOG_ERR("Unable to add block2 option.");
        goto end;
    }

    net_hexdump("Request", request.data, request.offset);

    r = send(sock, request.data, request.offset, 0);

end:
    k_free(data);

    return r;
}

static int get_large_coap_msgs(void)
{
    int r;

    while (1)
    {
        /* Test CoAP Large GET method */
        printk("\nCoAP client Large GET (block %zd)\n",
               blk_ctx.current / 64 /*COAP_BLOCK_64*/);
        r = send_large_coap_request();
        if (r < 0)
        {
            return r;
        }

        r = process_large_coap_reply();
        if (r < 0)
        {
            return r;
        }

        /* Received last block */
        if (r == 1)
        {
            memset(&blk_ctx, 0, sizeof(blk_ctx));
            return 0;
        }
    }

    return 0;
}

static int send_obs_reply_ack(u16_t id, u8_t *token, u8_t tkl)
{
    struct coap_packet request;
    u8_t *data;
    int r;

    data = (u8_t *)k_malloc(MAX_COAP_MSG_LEN);
    if (!data)
    {
        return -ENOMEM;
    }

    r = coap_packet_init(&request, data, MAX_COAP_MSG_LEN,
                         1, COAP_TYPE_ACK, tkl, token, 0, id);
    if (r < 0)
    {
        LOG_ERR("Failed to init CoAP message");
        goto end;
    }

    net_hexdump("Request", request.data, request.offset);

    r = send(sock, request.data, request.offset, 0);
end:
    k_free(data);

    return r;
}

static int process_obs_coap_reply(void)
{
    struct coap_packet reply;
    u16_t id;
    u8_t token[8];
    u8_t *data;
    u8_t type;
    u8_t tkl;
    int rcvd;
    int ret;

    wait();

    data = (u8_t *)k_malloc(MAX_COAP_MSG_LEN);
    if (!data)
    {
        return -ENOMEM;
    }

    rcvd = recv(sock, data, MAX_COAP_MSG_LEN, MSG_DONTWAIT);
    if (rcvd == 0)
    {
        ret = -EIO;
        goto end;
    }

    if (rcvd < 0)
    {
        if (errno == EAGAIN || errno == EWOULDBLOCK)
        {
            ret = 0;
        }
        else
        {
            ret = -errno;
        }

        goto end;
    }

    net_hexdump("Response", data, rcvd);

    ret = coap_packet_parse(&reply, data, rcvd, NULL, 0);
    if (ret < 0)
    {
        LOG_ERR("Invalid data received");
        goto end;
    }

    tkl = coap_header_get_token(&reply, (u8_t *)token);
    id = coap_header_get_id(&reply);

    type = coap_header_get_type(&reply);
    if (type == COAP_TYPE_ACK)
    {
        ret = 0;
    }
    else if (type == COAP_TYPE_CON)
    {
        ret = send_obs_reply_ack(id, token, tkl);
    }
end:
    k_free(data);

    return ret;
}

static int send_obs_coap_request(void)
{
    struct coap_packet request;
    const char *const *p;
    u8_t *data;
    int r;

    data = (u8_t *)k_malloc(MAX_COAP_MSG_LEN);
    if (!data)
    {
        return -ENOMEM;
    }

    r = coap_packet_init(&request, data, MAX_COAP_MSG_LEN,
                         1, COAP_TYPE_CON, 8, coap_next_token(),
                         COAP_METHOD_GET, coap_next_id());
    if (r < 0)
    {
        LOG_ERR("Failed to init CoAP message");
        goto end;
    }

    r = coap_append_option_int(&request, COAP_OPTION_OBSERVE, 0);
    if (r < 0)
    {
        LOG_ERR("Failed to append Observe option");
        goto end;
    }

    for (p = obs_path; p && *p; p++)
    {
        r = coap_packet_append_option(&request, COAP_OPTION_URI_PATH,
                                      *p, strlen(*p));
        if (r < 0)
        {
            LOG_ERR("Unable add option to request");
            goto end;
        }
    }

    net_hexdump("Request", request.data, request.offset);

    r = send(sock, request.data, request.offset, 0);

end:
    k_free(data);

    return r;
}

static int send_obs_reset_coap_request(void)
{
    struct coap_packet request;
    const char *const *p;
    u8_t *data;
    int r;

    data = (u8_t *)k_malloc(MAX_COAP_MSG_LEN);
    if (!data)
    {
        return -ENOMEM;
    }

    r = coap_packet_init(&request, data, MAX_COAP_MSG_LEN,
                         1, COAP_TYPE_RESET, 8, coap_next_token(),
                         0, coap_next_id());
    if (r < 0)
    {
        LOG_ERR("Failed to init CoAP message");
        goto end;
    }

    r = coap_append_option_int(&request, COAP_OPTION_OBSERVE, 0);
    if (r < 0)
    {
        LOG_ERR("Failed to append Observe option");
        goto end;
    }

    for (p = obs_path; p && *p; p++)
    {
        r = coap_packet_append_option(&request, COAP_OPTION_URI_PATH,
                                      *p, strlen(*p));
        if (r < 0)
        {
            LOG_ERR("Unable add option to request");
            goto end;
        }
    }

    net_hexdump("Request", request.data, request.offset);

    r = send(sock, request.data, request.offset, 0);

end:
    k_free(data);

    return r;
}

static int register_observer(void)
{
    u8_t counter = 0U;
    int r;

    while (1)
    {
        /* Test CoAP OBS GET method */
        if (!counter)
        {
            printk("\nCoAP client OBS GET\n");
            r = send_obs_coap_request();
            if (r < 0)
            {
                return r;
            }
        }
        else
        {
            printk("\nCoAP OBS Notification\n");
        }

        r = process_obs_coap_reply();
        if (r < 0)
        {
            return r;
        }

        counter++;

        /* Unregister */
        if (counter == 5U)
        {
            /* TODO: Functionality can be verified byt waiting for
			 * some time and make sure client shouldn't receive
			 * any notifications. If client still receives
			 * notifications means, Observer is not removed.
			 */
            return send_obs_reset_coap_request();
        }
    }

    return 0;
}

// void main(void)
// {
//     int r;

//     LOG_DBG("Start CoAP-client sample");
//     r = start_coap_client();
//     if (r < 0)
//     {
//         goto quit;
//     }

//     /* GET, PUT, POST, DELETE */
//     r = send_simple_coap_msgs_and_wait_for_reply();
//     if (r < 0)
//     {
//         goto quit;
//     }

//     /* Block-wise transfer */
//     r = get_large_coap_msgs();
//     if (r < 0)
//     {
//         goto quit;
//     }

//     /* Register observer, get notifications and unregister */
//     r = register_observer();
//     if (r < 0)
//     {
//         goto quit;
//     }

//     /* Close the socket */
//     (void)close(sock);

//     LOG_DBG("Done");

//     return;

// quit:
//     (void)close(sock);

//     LOG_ERR("quit");
// }
```
